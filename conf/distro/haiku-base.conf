## conf/distro/haiku-base.conf
```bitbake
# Distribution definition for: haiku-base
#
# Copyright (c) 2017 Oliver Ruiz Dorantes
# All rights reserved.
#

require conf/distro/poky.conf

DISTRO = "haiku-base"
DISTRO_NAME = "Haiku OS"
DISTRO_VERSION = "oLKa5"
DISTRO_CODENAME = "HoLKa5"
```

## conf/layer.conf
```bitbake
# We have a conf and classes directory, add to BBPATH
BBPATH .= ":${LAYERDIR}"

# We have recipes-* directories, add to BBFILES
BBFILES += "${LAYERDIR}/recipes-*/*/*.bb \
	${LAYERDIR}/recipes-*/*/*.bbappend"

BBFILE_COLLECTIONS += "haiku"
BBFILE_PATTERN_haiku = "^${LAYERDIR}/"
BBFILE_PRIORITY_haiku = "6"

LAYERSERIES_COMPAT_haiku = "sumo"
```
